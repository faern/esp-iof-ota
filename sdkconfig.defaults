## sdkconfig.defaults
```kconfig
# Rust often needs a bit of an extra main task stack size compared to C (the default is 3K)
CONFIG_ESP_MAIN_TASK_STACK_SIZE=7000

# Use this to set FreeRTOS kernel tick frequency to 1000 Hz (100 Hz by default).
# This allows to use 1 ms granuality for thread sleeps (10 ms by default).
#CONFIG_FREERTOS_HZ=1000

# Workaround for https://github.com/espressif/esp-idf/issues/7631
#CONFIG_MBEDTLS_CERTIFICATE_BUNDLE=n
#CONFIG_MBEDTLS_CERTIFICATE_BUNDLE_DEFAULT_FULL=n

CONFIG_RTC_CLOCK_BBPLL_POWER_ON_WITH_USB=y
CONFIG_ESP_PHY_ENABLE_USB=y

CONFIG_ESP_CONSOLE_USB_SERIAL_JTAG=y

# Enable https server
CONFIG_ESP_HTTPS_SERVER_ENABLE=y
# FIXME: The https session handshakes takes forever. Must be a better way?
CONFIG_ESP_TASK_WDT_TIMEOUT_S=10
```
